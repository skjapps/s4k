#include <Arduino.h>
// #include <BleConnectionStatus.h>
#include <BleCompositeHID.h>
#include <KeyboardDevice.h>
#include <MouseDevice.h>
#include <GamepadDevice.h>
#include <XboxGamepadDevice.h>
#include <U8g2lib.h>

#include <Wire.h> // library requires for IIC communication

/////////////////////////////
//        Graphics         //
/////////////////////////////
U8G2_SSD1306_128X64_NONAME_F_HW_I2C u8g2(U8G2_R0, /* reset=*/ U8X8_PIN_NONE); // initialization for the used OLED display

// Images
static const unsigned char image_battery_full_bits[] U8X8_PROGMEM = {0x00,0x00,0x00,0xf0,0xff,0x7f,0x08,0x00,0x80,0x68,0xdb,0xb6,0x6e,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0x00,0x00};
static const unsigned char image_bluetooth_bits[] U8X8_PROGMEM = {0x80,0x00,0x40,0x01,0x40,0x02,0x44,0x04,0x48,0x04,0x50,0x02,0x60,0x01,0xc0,0x00,0x60,0x01,0x50,0x02,0x48,0x04,0x44,0x04,0x40,0x02,0x40,0x01,0x80,0x00,0x00,0x00};

// Mode Select
static const unsigned char image_paint_0_bits[] U8X8_PROGMEM = {0x00,0x00,0x00,0x00,0x00,0x00,0x00,0x00,0x00,0x00,0x00,0x00,0x80,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0x00,0x00};


// Controlling the whole program
// This needs a better name? the main state of whats happening
int main_state;
// Mode is the function of the controller (mouse, keyboard, or gamepad)
int mode;


// Inputs n stuff
#define BUTTON_A_PIN 13
#define BUTTON_LEFT_PIN 16
#define BUTTON_RIGHT_PIN 17

int buttonAState;
int buttonLeftState;
int buttonRightState;



// The bluetooth LE Gamepad, Mouse and Keyboard Libraries
// Huge thanks to T-vK for Mouse and Keyboard, lemmingDev for Gamepad, and contributers
// https://github.com/T-vK/ESP32-BLE-Mouse, https://github.com/T-vK/ESP32-BLE-Keyboard, https://github.com/lemmingDev/ESP32-BLE-Gamepad
// 100 = 100% battery, to change...
XboxGamepadDevice *gamepad;
KeyboardDevice keyboard;
MouseDevice mouse;
BleCompositeHID compositeHID("SKJAPPS Controller", "skjapps", 100);

void setup() {
  u8g2.begin(); // start the u8g2 library

  // put your setup code here, to run once:
  Serial.begin(115200);
  Serial.println("Booting SKJAPPS Controller Software...");

  // Setting Inputs
  pinMode(BUTTON_A_PIN, INPUT_PULLUP);
  pinMode(BUTTON_LEFT_PIN, INPUT_PULLUP);
  pinMode(BUTTON_RIGHT_PIN, INPUT_PULLUP);

  // Setting control variables
  mode = 1;
  main_state = 1;

}

void loop() {
  // put your main code here, to run repeatedly:

  // Read button states
  buttonAState = digitalRead(BUTTON_A_PIN);
  buttonLeftState = digitalRead(BUTTON_LEFT_PIN);
  buttonRightState = digitalRead(BUTTON_RIGHT_PIN);
  
  // Update LED based on button A state
  // digitalWrite(LED_PIN, buttonAState == LOW ? HIGH : LOW);

  Serial.printf("Button A: %d, Left Button: %d, Right Button: %d \n", buttonAState, buttonLeftState, buttonRightState);

  // Choosing feature
  FeatureControl();

  // delay(10); // this speeds up the simulation
}

// To control the whole thing
// Basically running the needed "feature" function
// Or "choosing" the right loop
void FeatureControl () {
    switch(main_state) {
      case 0:
        Serial.printf("Idle state...?");
      case 1:
        // Choosing mode
        ModeSelect();
        break;
      case 2:
        // "Waiting for connection" screen
        ConnectWait();
        break;
      case 3:
        // Connected Screen.
        BleGamepadRunner();
        break;
    }
}

// "Feature" Functions
void ModeSelect() {
  
  // Choosing Mode Process
  if(!buttonAState) {
    BleSetup();
    main_state = 2;
  }
  else if (!buttonLeftState) {
    mode = (mode + 1) % 3 + 1; // Increment by 1 for left button
  } else if (!buttonRightState) {
    mode = mode % 3 + 1; // No change for right button (keeps current value)
  }
  
  // Display the mode graphics
  ModeSelectScreen(mode);

}

void ConnectWait() {

  // Go Back to mode select
  if(!buttonAState) {
    main_state = 1;
  }

  // Display the wait graphics
  ConnectionScreen(0);

  // to move to a function when im saying "connected" then maybe show button inputs live?
  BleGamepadRunner();

}

// The function to be called to setup the BleLibrary
void BleSetup() {

  switch(mode) {
    // Setup BLEGamepad
    // case 1:
    //   // BLE Gamepad Config struct
    //   BleGamepadConfiguration bleGamepadConfig;
    //   bleGamepadConfig.setControllerType(CONTROLLER_TYPE_GAMEPAD); // CONTROLLER_TYPE_JOYSTICK, CONTROLLER_TYPE_GAMEPAD (DEFAULT), CONTROLLER_TYPE_MULTI_AXIS
    //   // Logitech Standard Gamepad
    //   bleGamepadConfig.setVid(0x046D);
    //   bleGamepadConfig.setPid(0xC216);
    //   // Only X axis (left thumb x)
    //   bleGamepadConfig.setWhichAxes(true, false, false, false, false, false, false, false);
    //   // Start the gamepad service
    //   bleGamepad.begin(&bleGamepadConfig);

    // // Setup BleMouse
    // case 2:
    //   bleMouse.begin();

    // // Setup BleKeyboard
    // case 3:
    //   bleKeyboard.begin();
    // Add all devices to the composite HID device to manage them
    default:

      // Xbox controller
      XboxOneSControllerDeviceConfiguration* config = new XboxOneSControllerDeviceConfiguration();

      // The composite HID device pretends to be a valid Xbox controller via vendor and product IDs (VID/PID).
      // Platforms like windows/linux need this in order to pick an XInput driver over the generic BLE GATT HID driver. 
      BLEHostConfiguration hostConfig = config->getIdealHostConfiguration();

      // Set up gamepad
      gamepad = new XboxGamepadDevice(config);

      // Add all devices to the composite HID device to manage them
      compositeHID.addDevice(&keyboard);
      compositeHID.addDevice(&mouse);
      compositeHID.addDevice(&gamepad);

      // Start the composite HID device to broadcast HID reports
      compositeHID.begin();
      break;
  }
  
}

//////////////////////////
//   Controller Logic   //
//////////////////////////
// Named "Runner"(s) to avoid confusion
// void BleGamepadRunner() {
//   if (bleGamepad.isConnected())
//   {
//     // Goes to the "connected!" screen state
//     main_state = 3;

//     // Press Button 1 for A
//     if(!buttonAState) {
//       bleGamepad.press(BUTTON_2);
//     } else {
//       bleGamepad.release(BUTTON_2);
//     }
    
//     // 0 = Left, 16384 = Middle, 32767 = Right
//     if(!buttonLeftState) {
//       bleGamepad.setLeftThumb(0, 16384);
//     } else if (!buttonRightState) {
//       bleGamepad.setLeftThumb(32767, 16384);
//     } else {
//       // Joystick middle state
//       bleGamepad.setLeftThumb(16384, 16384);
//     }

//     // Show connected screen
//     ConnectionScreen(1);
//   } else {
//     // Lost connection, return to waiting screen.
//     main_state = 2;
//   }
// }

// void BleMouseRunner() {
//   if (bleMouse.isConnected())
//   {
//     // Goes to the "connected!" screen state
//     main_state = 3;

//     // Press Button 1 for A
//     if(!buttonAState) {
//       // Default : MOUSE_LEFT
//       bleMouse.press();
//     } else {
//       bleMouse.release();
//     }
    
//     // Directional Movement
//     // Mouse.move(xVal, yVal, wheel)
//     if(!buttonLeftState) {
//       bleMouse.move(-20, 0, 0);
//     } else if (!buttonRightState) {
//       bleMouse.move(20, 0, 0);
//     }

//     // Show connected screen
//     ConnectionScreen(1);

//   } else {
//     // Lost connection, return to waiting screen.
//     main_state = 2;
//   }
// }

// void BleKeyboardRunner() {
//   if (bleKeyboard.isConnected())
//   {
//     // Goes to the "connected!" screen state
//     main_state = 3;

//     // All functions
//     if (!buttonAState) {
//       bleKeyboard.press(KEY_SPACE);    
//     } else if (!buttonLeftState) {
//       bleKeyboard.press(KEY_LEFT);
//     } else if (!buttonRightState) {
//       bleKeyboard.move(KEY_RIGHT);
//     } else {
//       // Releases all keys, efficient.
//       bleKeyboard.releaseAll();
//     }

//     // Show connected screen
//     ConnectionScreen(1);

//   } else {
//     // Lost connection, return to waiting screen.
//     main_state = 2;
//   }
// }

void CompositeRunner() {
  if(compositeHID.isConnected()){
    // Goes to the "connected!" screen state
    main_state = 3;

    // Moved from multiple runners
    switch(mode) {
      // Controller
      case 1:
        // Press Button 1 for A
        if(!buttonAState) {
          gamepad->press(XBOX_BUTTON_A);
        } else {
          gamepad->release(XBOX_BUTTON_A);
        }
        
        // 0 = Left, 16384 = Middle, 32767 = Right
        if(!buttonLeftState) {
          gamepad->setLeftThumb(0, 16384);
        } else if (!buttonRightState) {
          gamepad->setLeftThumb(32767, 16384);
        } else {
          // Joystick middle state
          gamepad->setLeftThumb(16384, 16384);
        }
      // Mouse
      case 2:
        // Press Button 1 for A
        if(!buttonAState) {
          // Default : MOUSE_LEFT
          mouse->press();
        } else {
          mouse->release();
        }
        
        // Directional Movement
        // Mouse.move(xVal, yVal, wheel)
        if(!buttonLeftState) {
          mouse->move(-20, 0, 0);
        } else if (!buttonRightState) {
          mouse->move(20, 0, 0);
        }
      // Keyboard
      case 3:
        // All functions
        if (!buttonAState) {
          keyboard->press(KEY_SPACE);    
        } else if (!buttonLeftState) {
          keyboard->press(KEY_LEFT);
        } else if (!buttonRightState) {
          keyboard->press(KEY_RIGHT);
        } else {
          // Releases all keys, efficient.
          keyboard->releaseAll();
        }
    }

    // Show connected screen
    ConnectionScreen(1);
  } else {
    // Lost connection, return to waiting screen.
    main_state = 2;
  }
}

////////////////////////
// Graphics Functions //
////////////////////////

void ConnectionScreen(bool connected) {
  u8g2.clearBuffer();
  u8g2.setFontMode(1);
  u8g2.setBitmapMode(1);
  u8g2.drawXBM(101, 2, 24, 16, image_battery_full_bits);
  u8g2.drawLine(124, 19, 2, 19);
  u8g2.drawXBM(20, 32, 14, 16, image_bluetooth_bits);
  u8g2.setFont(u8g2_font_6x12_tr);
  if(!connected) {
    u8g2.drawStr(42, 39, "Waiting for");
    u8g2.drawStr(44, 49, "Connection");
  } else u8g2.drawStr(39, 43, "Connected!");
  u8g2.sendBuffer();
}

void ModeSelectScreen(int Mode) {
  u8g2.clearBuffer();
  u8g2.setFontMode(1);
  u8g2.setBitmapMode(1);
  
  // Display Selection
  switch(mode) {
    case 1:
      // Gamepad Mode
      u8g2.drawFrame(2, 23, 37, 37);
      break;
    case 2:
      // Mouse Mode
      u8g2.drawFrame(43, 23, 37, 37);
      break;
    case 3:
      // Keyboard Mode
      u8g2.drawFrame(80, 23, 44, 37);
      break;
  }

  u8g2.setDrawColor(2);
  u8g2.drawXBM(2, 3, 123, 54, image_paint_0_bits);
  u8g2.sendBuffer();
}